## zmk/src/zmk-config/config/boards/shields/popup/Kconfig.defconfig
```kconfig
if SHIELD_POPUP_LEFT

config ZMK_KEYBOARD_NAME
    default "Pop-Up"

config ZMK_SPLIT_BLE_ROLE_CENTRAL
    default y

endif

if SHIELD_POPUP_RIGHT

config ZMK_KEYBOARD_NAME
	default "Pop-Up Right"

endif

if SHIELD_POPUP_LEFT || SHIELD_POPUP_RIGHT

config ZMK_SPLIT
    default y

endif
```

## zmk/src/zmk-config/config/boards/shields/popup/Kconfig.shield
```kconfig
config SHIELD_POPUP_LEFT
	def_bool $(shields_list_contains,popup_left)

config SHIELD_POPUP_RIGHT
	def_bool $(shields_list_contains,popup_right)
```
